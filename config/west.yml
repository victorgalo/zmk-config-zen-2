## config/west.yml
```yaml
manifest:
  remotes:
    - name: victorgalo
      url-base: https://github.com/victorgalo
  projects:
    - name: zmk
      remote: victorgalo
      revision: main
      import: app/west.yml
  self:
    path: config
```
